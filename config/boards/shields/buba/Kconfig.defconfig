## config/boards/shields/buba/Kconfig.defconfig
```kconfig
if SHIELD_BUBA_LEFT

config ZMK_KEYBOARD_NAME
    default "BUBA keyboard"

config ZMK_SPLIT_ROLE_CENTRAL
    default y

endif

if SHIELD_BUBA_LEFT || SHIELD_BUBA_RIGHT

config ZMK_SPLIT
    default y

endif
```

## config/boards/shields/buba/Kconfig.shield
```kconfig
config SHIELD_BUBA_LEFT
    def_bool $(shields_list_contains,buba_left)

config SHIELD_BUBA_RIGHT
    def_bool $(shields_list_contains,buba_right)
```
